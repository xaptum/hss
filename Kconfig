## Kconfig
```kconfig
#
# XAP-RC-00x
#

config HSS
        tristate "HSS Host side driver"
        depends on USB_SUPPORT
        ---help---

          Say Y here if you want to support HSS enabled USB
	  devices

          To compile this driver as a module, choose M here. The
          module will be called hss.

If unsure, say M.
```
